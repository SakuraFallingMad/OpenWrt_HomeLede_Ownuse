## defconfig
```kconfig
CONFIG_TARGET_x86=y
CONFIG_TARGET_x86_64=y
CONFIG_TARGET_x86_64_DEVICE_generic=y
CONFIG_ATH9K_HWRNG=y
CONFIG_B43LEGACY_FW_SQUASH=y
CONFIG_B43LEGACY_FW_SQUASH_COREREVS="1,2,3,4"
CONFIG_B43_FW_5_100_138=y
CONFIG_B43_FW_SQUASH=y
CONFIG_B43_FW_SQUASH_COREREVS="5,6,7,8,9,10,11,13,15,16,28,29,30"
CONFIG_B43_FW_SQUASH_PHYTYPES="G,N,LP,HT"
CONFIG_BRCMFMAC_PCIE=y
CONFIG_BRCMFMAC_USB=y
CONFIG_BRCMSMAC_USE_FW_FROM_WL=y
CONFIG_DRIVER_WEXT_SUPPORT=y
CONFIG_DROPBEAR_ECC=y
CONFIG_DROPBEAR_ECC_FULL=y
CONFIG_DROPBEAR_ZLIB=y
# CONFIG_FEED_homeclash is not set
# CONFIG_FEED_infinityfreedom is not set
# CONFIG_FEED_jerrykuku is not set
# CONFIG_FEED_lienol is not set
# CONFIG_FEED_pw2_luci is not set
# CONFIG_FEED_pw_luci is not set
# CONFIG_FEED_pw_packages is not set
# CONFIG_FEED_strongswanInDocker is not set
# CONFIG_FEED_xiaoqingfeng is not set
CONFIG_GNUTLS_ALPN=y
CONFIG_GNUTLS_ANON=y
CONFIG_GNUTLS_DTLS_SRTP=y
CONFIG_GNUTLS_HEARTBEAT=y
CONFIG_GNUTLS_OCSP=y
CONFIG_GNUTLS_PSK=y
CONFIG_GNUTLS_SRP=y
CONFIG_GRUB_IMAGES=y
CONFIG_GRUB_TITLE="HomeLede"
CONFIG_IPTABLES_CONNLABEL=y
CONFIG_IPTABLES_NFTABLES=y
# CONFIG_KERNEL_BLK_DEV_THROTTLING is not set
CONFIG_KERNEL_BTRFS_FS_POSIX_ACL=y
CONFIG_KERNEL_CFQ_GROUP_IOSCHED=y
# CONFIG_KERNEL_CFS_BANDWIDTH is not set
CONFIG_KERNEL_CGROUP_DEVICE=y
CONFIG_KERNEL_CGROUP_FREEZER=y
CONFIG_KERNEL_CGROUP_HUGETLB=y
CONFIG_KERNEL_CGROUP_NET_PRIO=y
CONFIG_KERNEL_CGROUP_PERF=y
CONFIG_KERNEL_EXT4_FS_POSIX_ACL=y
CONFIG_KERNEL_EXT4_FS_SECURITY=y
CONFIG_KERNEL_FS_POSIX_ACL=y
CONFIG_KERNEL_HUGETLBFS=y
CONFIG_KERNEL_HUGETLB_PAGE=y
# CONFIG_KERNEL_MEMCG_SWAP is not set
CONFIG_KERNEL_NET_CLS_CGROUP=y
CONFIG_KERNEL_PERF_EVENTS=y
CONFIG_KERNEL_TRANSPARENT_HUGEPAGE=y
CONFIG_KERNEL_TRANSPARENT_HUGEPAGE_ALWAYS=y
CONFIG_LIBMBEDTLS_HAVE_SSE2=y
CONFIG_LIBMBEDTLS_HKDF_C=y
CONFIG_LUCI_LANG_en=y
CONFIG_NGINX_HEADERS_MORE=y
CONFIG_NGINX_HTTP_ACCESS=y
CONFIG_NGINX_HTTP_AUTH_BASIC=y
CONFIG_NGINX_HTTP_AUTOINDEX=y
CONFIG_NGINX_HTTP_BROWSER=y
CONFIG_NGINX_HTTP_CACHE=y
CONFIG_NGINX_HTTP_CHARSET=y
CONFIG_NGINX_HTTP_EMPTY_GIF=y
CONFIG_NGINX_HTTP_FASTCGI=y
CONFIG_NGINX_HTTP_GEO=y
CONFIG_NGINX_HTTP_GZIP=y
CONFIG_NGINX_HTTP_LIMIT_CONN=y
CONFIG_NGINX_HTTP_LIMIT_REQ=y
CONFIG_NGINX_HTTP_MAP=y
CONFIG_NGINX_HTTP_MEMCACHED=y
CONFIG_NGINX_HTTP_PROXY=y
CONFIG_NGINX_HTTP_REFERER=y
CONFIG_NGINX_HTTP_REWRITE=y
CONFIG_NGINX_HTTP_SCGI=y
CONFIG_NGINX_HTTP_SPLIT_CLIENTS=y
CONFIG_NGINX_HTTP_SSI=y
CONFIG_NGINX_HTTP_UPSTREAM_HASH=y
CONFIG_NGINX_HTTP_UPSTREAM_IP_HASH=y
CONFIG_NGINX_HTTP_UPSTREAM_KEEPALIVE=y
CONFIG_NGINX_HTTP_UPSTREAM_LEAST_CONN=y
CONFIG_NGINX_HTTP_USERID=y
CONFIG_NGINX_HTTP_UWSGI=y
CONFIG_NGINX_HTTP_V2=y
CONFIG_NGINX_NAXSI=y
CONFIG_NGINX_PCRE=y
CONFIG_NGINX_UBUS=y
CONFIG_OPENCONNECT_OPENSSL=y
CONFIG_OPENSSL_WITH_ARIA=y
CONFIG_OPENSSL_WITH_BLAKE2=y
CONFIG_OPENSSL_WITH_CAMELLIA=y
CONFIG_OPENSSL_WITH_COMPRESSION=y
CONFIG_OPENSSL_WITH_DTLS=y
CONFIG_OPENSSL_WITH_EC2M=y
CONFIG_OPENSSL_WITH_IDEA=y
CONFIG_OPENSSL_WITH_MDC2=y
CONFIG_OPENSSL_WITH_NPN=y
CONFIG_OPENSSL_WITH_RFC3779=y
CONFIG_OPENSSL_WITH_SEED=y
CONFIG_OPENSSL_WITH_SM234=y
CONFIG_OPENSSL_WITH_WHIRLPOOL=y
CONFIG_OPENVPN_openssl_ENABLE_DEF_AUTH=y
CONFIG_OPENVPN_openssl_ENABLE_FRAGMENT=y
CONFIG_OPENVPN_openssl_ENABLE_IPROUTE2=y
CONFIG_OPENVPN_openssl_ENABLE_LZ4=y
CONFIG_OPENVPN_openssl_ENABLE_LZO=y
CONFIG_OPENVPN_openssl_ENABLE_MANAGEMENT=y
CONFIG_OPENVPN_openssl_ENABLE_MULTIHOME=y
CONFIG_OPENVPN_openssl_ENABLE_PF=y
CONFIG_OPENVPN_openssl_ENABLE_PORT_SHARE=y
CONFIG_OPENVPN_openssl_ENABLE_SMALL=y
CONFIG_OPENVPN_openssl_ENABLE_X509_ALT_USERNAME=y
CONFIG_PACKAGE_6rd=y
CONFIG_PACKAGE_6to4=y
CONFIG_PACKAGE_B43_BUSES_BCMA_AND_SSB=y
CONFIG_PACKAGE_B43_PHY_G=y
CONFIG_PACKAGE_B43_PHY_HT=y
CONFIG_PACKAGE_B43_PHY_LP=y
CONFIG_PACKAGE_B43_PHY_N=y
CONFIG_PACKAGE_B43_USE_BCMA=y
CONFIG_PACKAGE_B43_USE_SSB=y
CONFIG_PACKAGE_UnblockNeteaseMusic-Go=m
CONFIG_PACKAGE_acpid=y
CONFIG_PACKAGE_aggregate=y
CONFIG_PACKAGE_aliyundrive-webdav=m
CONFIG_PACKAGE_alsa-lib=m
CONFIG_PACKAGE_alsa-ucm-conf=m
CONFIG_PACKAGE_alsa-utils=m
CONFIG_PACKAGE_amd64-microcode=y
CONFIG_PACKAGE_announce=y
# CONFIG_PACKAGE_ath10k-board-qca9888 is not set
# CONFIG_PACKAGE_ath10k-board-qca988x is not set
# CONFIG_PACKAGE_ath10k-board-qca9984 is not set
# CONFIG_PACKAGE_ath10k-firmware-qca9888 is not set
# CONFIG_PACKAGE_ath10k-firmware-qca988x is not set
# CONFIG_PACKAGE_ath10k-firmware-qca9984 is not set
CONFIG_PACKAGE_avahi-autoipd=y
CONFIG_PACKAGE_avahi-daemon-service-http=y
CONFIG_PACKAGE_avahi-daemon-service-ssh=y
CONFIG_PACKAGE_avahi-dbus-daemon=y
CONFIG_PACKAGE_avahi-dnsconfd=y
CONFIG_PACKAGE_avahi-utils=y
CONFIG_PACKAGE_b43legacy-firmware=y
CONFIG_PACKAGE_bind-client=y
CONFIG_PACKAGE_blkid=m
CONFIG_PACKAGE_boost=y
CONFIG_PACKAGE_boost-date_time=m
CONFIG_PACKAGE_boost-program_options=y
CONFIG_PACKAGE_boost-system=y
# CONFIG_PACKAGE_brcmfmac-firmware-43602a1-pcie is not set
CONFIG_PACKAGE_brcmfmac-firmware-usb=y
CONFIG_PACKAGE_brook=y
CONFIG_PACKAGE_carl9170-firmware=y
# CONFIG_PACKAGE_cfdisk is not set
CONFIG_PACKAGE_coreutils-base64=y
CONFIG_PACKAGE_dbus=y
CONFIG_PACKAGE_ddns-scripts_cloudflare.com-v4=y
CONFIG_PACKAGE_ddns-scripts_cnkuai_cn=y
CONFIG_PACKAGE_ddns-scripts_digitalocean.com-v2=y
CONFIG_PACKAGE_ddns-scripts_freedns_42_pl=y
CONFIG_PACKAGE_ddns-scripts_godaddy.com-v1=y
CONFIG_PACKAGE_ddns-scripts_no-ip_com=y
CONFIG_PACKAGE_ddns-scripts_nsupdate=y
CONFIG_PACKAGE_ddns-scripts_route53-v1=y
CONFIG_PACKAGE_dns2socks=y
CONFIG_PACKAGE_dns2tcp=y
CONFIG_PACKAGE_dnscrypt-proxy2=y
CONFIG_PACKAGE_dnsmasq_full_auth=y
CONFIG_PACKAGE_dnsmasq_full_conntrack=y
CONFIG_PACKAGE_dnsmasq_full_dhcpv6=y
CONFIG_PACKAGE_dnsmasq_full_dnssec=y
CONFIG_PACKAGE_drill=y
CONFIG_PACKAGE_dropbearconvert=y
CONFIG_PACKAGE_fdisk=y
CONFIG_PACKAGE_flock=m
CONFIG_PACKAGE_frpc=m
CONFIG_PACKAGE_frps=m
CONFIG_PACKAGE_getopt=m
CONFIG_PACKAGE_giflib-utils=y
CONFIG_PACKAGE_gre=y
CONFIG_PACKAGE_haproxy=y
CONFIG_PACKAGE_hostip=y
CONFIG_PACKAGE_hysteria=y
CONFIG_PACKAGE_intel-microcode=y
CONFIG_PACKAGE_ip6tables-extra=y
CONFIG_PACKAGE_ip6tables-mod-nat=y
CONFIG_PACKAGE_ip6tables-nft=y
CONFIG_PACKAGE_ipip=y
CONFIG_PACKAGE_iptables-mod-checksum=y
CONFIG_PACKAGE_iptables-mod-cluster=y
CONFIG_PACKAGE_iptables-mod-clusterip=y
CONFIG_PACKAGE_iptables-mod-conntrack-label=y
CONFIG_PACKAGE_iptables-mod-hashlimit=y
CONFIG_PACKAGE_iptables-mod-ipsec=y
CONFIG_PACKAGE_iptables-mod-led=y
CONFIG_PACKAGE_iptables-mod-nat-extra=y
CONFIG_PACKAGE_iptables-mod-nflog=y
CONFIG_PACKAGE_iptables-mod-nfqueue=y
CONFIG_PACKAGE_iptables-mod-physdev=y
CONFIG_PACKAGE_iptables-mod-rpfilter=y
CONFIG_PACKAGE_iptables-mod-rtpengine=y
CONFIG_PACKAGE_iptables-mod-tee=y
CONFIG_PACKAGE_iptables-mod-trace=y
CONFIG_PACKAGE_iptables-mod-u32=y
CONFIG_PACKAGE_iptables-mod-ulog=y
CONFIG_PACKAGE_iptables-nft=y
CONFIG_PACKAGE_iputils-arping=m
# CONFIG_PACKAGE_iw is not set
CONFIG_PACKAGE_iw-full=y
CONFIG_PACKAGE_jq=m
CONFIG_PACKAGE_kcptun-client=m
CONFIG_PACKAGE_kcptun-config=m
CONFIG_PACKAGE_kmod-ac97=m
CONFIG_PACKAGE_kmod-adm8211=y
# CONFIG_PACKAGE_kmod-alx is not set
CONFIG_PACKAGE_kmod-ar5523=y
CONFIG_PACKAGE_kmod-ath6kl=y
CONFIG_PACKAGE_kmod-ath6kl-sdio=y
CONFIG_PACKAGE_kmod-ath6kl-usb=y
CONFIG_PACKAGE_kmod-b43=y
CONFIG_PACKAGE_kmod-b43legacy=y
CONFIG_PACKAGE_kmod-bcma=y
CONFIG_PACKAGE_kmod-brcmfmac=y
CONFIG_PACKAGE_kmod-brcmsmac=y
CONFIG_PACKAGE_kmod-brcmutil=y
# CONFIG_PACKAGE_kmod-button-hotplug is not set
CONFIG_PACKAGE_kmod-carl9170=y
CONFIG_PACKAGE_kmod-crypto-cts=m
CONFIG_PACKAGE_kmod-crypto-deflate=y
CONFIG_PACKAGE_kmod-crypto-echainiv=y
CONFIG_PACKAGE_kmod-crypto-md4=y
CONFIG_PACKAGE_kmod-crypto-michael-mic=y
CONFIG_PACKAGE_kmod-dummy=y
CONFIG_PACKAGE_kmod-eeprom-93cx6=y
CONFIG_PACKAGE_kmod-fast-classifier=m
CONFIG_PACKAGE_kmod-fs-exportfs=m
CONFIG_PACKAGE_kmod-fs-nfs=m
CONFIG_PACKAGE_kmod-fs-nfs-common=m
CONFIG_PACKAGE_kmod-fs-nfs-common-rpcsec=m
CONFIG_PACKAGE_kmod-fs-nfs-ssc=m
CONFIG_PACKAGE_kmod-fs-nfs-v4=m
CONFIG_PACKAGE_kmod-fs-nfsd=m
CONFIG_PACKAGE_kmod-fs-ntfs=y
CONFIG_PACKAGE_kmod-fuse=y
CONFIG_PACKAGE_kmod-gre6=y
# CONFIG_PACKAGE_kmod-iavf is not set
CONFIG_PACKAGE_kmod-ifb=y
# CONFIG_PACKAGE_kmod-inet-diag is not set
CONFIG_PACKAGE_kmod-ip6-tunnel=y
CONFIG_PACKAGE_kmod-ip6tables-extra=y
CONFIG_PACKAGE_kmod-ipip=y
CONFIG_PACKAGE_kmod-ipsec=y
CONFIG_PACKAGE_kmod-ipsec4=y
CONFIG_PACKAGE_kmod-ipsec6=y
CONFIG_PACKAGE_kmod-ipt-checksum=y
CONFIG_PACKAGE_kmod-ipt-cluster=y
CONFIG_PACKAGE_kmod-ipt-clusterip=y
CONFIG_PACKAGE_kmod-ipt-conntrack-label=y
CONFIG_PACKAGE_kmod-ipt-debug=y
CONFIG_PACKAGE_kmod-ipt-hashlimit=y
CONFIG_PACKAGE_kmod-ipt-ipsec=y
CONFIG_PACKAGE_kmod-ipt-led=y
CONFIG_PACKAGE_kmod-ipt-nat-extra=y
CONFIG_PACKAGE_kmod-ipt-nflog=y
CONFIG_PACKAGE_kmod-ipt-nfqueue=y
CONFIG_PACKAGE_kmod-ipt-physdev=y
CONFIG_PACKAGE_kmod-ipt-raw6=y
CONFIG_PACKAGE_kmod-ipt-rpfilter=y
CONFIG_PACKAGE_kmod-ipt-rtpengine=y
CONFIG_PACKAGE_kmod-ipt-tee=y
CONFIG_PACKAGE_kmod-ipt-u32=y
CONFIG_PACKAGE_kmod-ipt-ulog=y
CONFIG_PACKAGE_kmod-iptunnel6=y
CONFIG_PACKAGE_kmod-ipw2100=y
CONFIG_PACKAGE_kmod-ipw2200=y
CONFIG_PACKAGE_kmod-iwlwifi=y
# CONFIG_PACKAGE_kmod-ixgbevf is not set
CONFIG_PACKAGE_kmod-ledtrig-audio=m
CONFIG_PACKAGE_kmod-lib-cordic=y
CONFIG_PACKAGE_kmod-lib-crc8=y
CONFIG_PACKAGE_kmod-lib80211=y
CONFIG_PACKAGE_kmod-libipw=y
CONFIG_PACKAGE_kmod-md-mod=m
CONFIG_PACKAGE_kmod-md-raid0=m
CONFIG_PACKAGE_kmod-md-raid1=m
CONFIG_PACKAGE_kmod-md-raid10=m
CONFIG_PACKAGE_kmod-md-raid456=m
CONFIG_PACKAGE_kmod-net-rtl8192su=y
CONFIG_PACKAGE_kmod-nfnetlink-log=y
CONFIG_PACKAGE_kmod-nfnetlink-queue=y
CONFIG_PACKAGE_kmod-nft-bridge=y
CONFIG_PACKAGE_kmod-nft-core=y
CONFIG_PACKAGE_kmod-nft-netdev=y
CONFIG_PACKAGE_kmod-regmap-core=m
CONFIG_PACKAGE_kmod-rtl8180=y
CONFIG_PACKAGE_kmod-rtl8187=y
CONFIG_PACKAGE_kmod-rtl8192c-common=y
CONFIG_PACKAGE_kmod-rtl8192ce=y
CONFIG_PACKAGE_kmod-rtl8192cu=y
CONFIG_PACKAGE_kmod-rtl8192de=y
CONFIG_PACKAGE_kmod-rtl8192se=y
CONFIG_PACKAGE_kmod-rtl8723bs=y
CONFIG_PACKAGE_kmod-rtl8821ae=y
CONFIG_PACKAGE_kmod-rtl8821cu=y
CONFIG_PACKAGE_kmod-rtlwifi=y
CONFIG_PACKAGE_kmod-rtlwifi-btcoexist=y
CONFIG_PACKAGE_kmod-rtlwifi-pci=y
CONFIG_PACKAGE_kmod-rtlwifi-usb=y
CONFIG_PACKAGE_kmod-rtw88=y
CONFIG_PACKAGE_kmod-sched-cake=y
CONFIG_PACKAGE_kmod-sched-connmark=y
CONFIG_PACKAGE_kmod-sched-core=y
CONFIG_PACKAGE_kmod-shortcut-fe=y
CONFIG_PACKAGE_kmod-shortcut-fe-cm=y
CONFIG_PACKAGE_kmod-sound-core=m
CONFIG_PACKAGE_kmod-sound-hda-codec-hdmi=m
CONFIG_PACKAGE_kmod-sound-hda-codec-realtek=m
CONFIG_PACKAGE_kmod-sound-hda-codec-via=m
CONFIG_PACKAGE_kmod-sound-hda-core=m
CONFIG_PACKAGE_kmod-sound-hda-intel=m
CONFIG_PACKAGE_kmod-sound-i8x0=m
CONFIG_PACKAGE_kmod-sound-mpu401=m
CONFIG_PACKAGE_kmod-sound-via82xx=m
CONFIG_PACKAGE_kmod-ssb=y
CONFIG_PACKAGE_kmod-tg3=y
CONFIG_PACKAGE_kmod-usb-audio=m
CONFIG_PACKAGE_kmod-usb-net-cdc-ether=y
CONFIG_PACKAGE_kmod-usb-net-cdc-ncm=y
CONFIG_PACKAGE_kmod-usb-net-rtl8152=y
# CONFIG_PACKAGE_kmod-usb-net-rtl8152-vendor is not set
CONFIG_PACKAGE_kmod-usb-printer=m
# CONFIG_PACKAGE_kmod-via-velocity is not set
CONFIG_PACKAGE_knot-host=y
CONFIG_PACKAGE_knot-libs=y
CONFIG_PACKAGE_libavahi-client=y
CONFIG_PACKAGE_libavahi-dbus-support=y
CONFIG_PACKAGE_libbfd=m
CONFIG_PACKAGE_libcares=y
CONFIG_PACKAGE_libconfig=m
CONFIG_PACKAGE_libcryptopp=m
CONFIG_PACKAGE_libdaemon=y
CONFIG_PACKAGE_libdbus=y
CONFIG_PACKAGE_libdouble-conversion=m
CONFIG_PACKAGE_libedit=y
# CONFIG_PACKAGE_libeudev is not set
CONFIG_PACKAGE_libev=y
CONFIG_PACKAGE_libevdev=y
CONFIG_PACKAGE_libexif=m
CONFIG_PACKAGE_libexpat=y
CONFIG_PACKAGE_libffmpeg-audio-dec=m
CONFIG_PACKAGE_libflac=m
CONFIG_PACKAGE_libfreetype=m
CONFIG_PACKAGE_libfuse=y
CONFIG_PACKAGE_libgcrypt=y
CONFIG_PACKAGE_libgd-full=m
CONFIG_PACKAGE_libgnutls=y
CONFIG_PACKAGE_libgpg-error=y
CONFIG_PACKAGE_libid3tag=m
CONFIG_PACKAGE_libjpeg-turbo=m
CONFIG_PACKAGE_libldns=y
CONFIG_PACKAGE_libltdl=y
CONFIG_PACKAGE_liblua5.3=y
# CONFIG_PACKAGE_liblzma is not set
CONFIG_PACKAGE_libmbedtls=y
CONFIG_PACKAGE_libminiupnpc=y
CONFIG_PACKAGE_libnatpmp=y
CONFIG_PACKAGE_libnetfilter-conntrack=y
CONFIG_PACKAGE_libnetsnmp=y
CONFIG_PACKAGE_libnettle=y
CONFIG_PACKAGE_libnfnetlink=y
CONFIG_PACKAGE_libogg=m
CONFIG_PACKAGE_libopenssl-gost_engine=y
CONFIG_PACKAGE_libp11=y
CONFIG_PACKAGE_libpcre2=m
CONFIG_PACKAGE_libpng=m
CONFIG_PACKAGE_libpopt=m
# CONFIG_PACKAGE_libpython3 is not set
CONFIG_PACKAGE_libsoxr=m
CONFIG_PACKAGE_libsqlite3=m
CONFIG_PACKAGE_libtasn1=y
CONFIG_PACKAGE_libtiff=m
CONFIG_PACKAGE_libudev-zero=y
CONFIG_PACKAGE_libudns=y
CONFIG_PACKAGE_libvorbis=m
CONFIG_PACKAGE_libwebp=m
CONFIG_PACKAGE_libxml2=y
CONFIG_PACKAGE_libxtables-nft=y
# CONFIG_PACKAGE_libyaml-cpp is not set
CONFIG_PACKAGE_libzip-gnutls=m
CONFIG_PACKAGE_lmdb=y
CONFIG_PACKAGE_lsblk=m
CONFIG_PACKAGE_luci-app-airplay2=m
CONFIG_PACKAGE_luci-app-aliyundrive-webdav=m
CONFIG_PACKAGE_luci-app-diskman=m
CONFIG_PACKAGE_luci-app-diskman_INCLUDE_kmod_md_linear=y
CONFIG_PACKAGE_luci-app-diskman_INCLUDE_kmod_md_raid456=y
CONFIG_PACKAGE_luci-app-diskman_INCLUDE_mdadm=y
CONFIG_PACKAGE_luci-app-frpc=m
CONFIG_PACKAGE_luci-app-frps=m
CONFIG_PACKAGE_luci-app-ipsec-vpnserver-manyusers=m
CONFIG_PACKAGE_luci-app-kodexplorer=m
CONFIG_PACKAGE_luci-app-minidlna=m
CONFIG_PACKAGE_luci-app-netdata=y
CONFIG_PACKAGE_luci-app-nft-qos=y
CONFIG_PACKAGE_luci-app-openclash=y
CONFIG_PACKAGE_luci-app-openvpn=m
CONFIG_PACKAGE_luci-app-openvpn-server=m
CONFIG_PACKAGE_luci-app-passwall=y
CONFIG_PACKAGE_luci-app-passwall2=m
CONFIG_PACKAGE_luci-app-passwall2_INCLUDE_Brook=y
CONFIG_PACKAGE_luci-app-passwall2_INCLUDE_Hysteria=y
CONFIG_PACKAGE_luci-app-passwall2_INCLUDE_IPv6_Nat=y
CONFIG_PACKAGE_luci-app-passwall2_INCLUDE_NaiveProxy=y
CONFIG_PACKAGE_luci-app-passwall2_INCLUDE_ShadowsocksR_Libev_Server=y
CONFIG_PACKAGE_luci-app-passwall2_INCLUDE_Shadowsocks_Libev_Server=y
CONFIG_PACKAGE_luci-app-passwall2_INCLUDE_Shadowsocks_Rust_Client=y
CONFIG_PACKAGE_luci-app-passwall_INCLUDE_Brook=y
CONFIG_PACKAGE_luci-app-passwall_INCLUDE_Hysteria=y
CONFIG_PACKAGE_luci-app-passwall_INCLUDE_IPv6_Nat=y
CONFIG_PACKAGE_luci-app-passwall_INCLUDE_NaiveProxy=y
CONFIG_PACKAGE_luci-app-passwall_INCLUDE_ShadowsocksR_Libev_Server=y
CONFIG_PACKAGE_luci-app-passwall_INCLUDE_Shadowsocks_Rust_Client=y
CONFIG_PACKAGE_luci-app-passwall_INCLUDE_Trojan_GO=y
# CONFIG_PACKAGE_luci-app-passwall_INCLUDE_V2ray is not set
CONFIG_PACKAGE_luci-app-pptp-server=m
CONFIG_PACKAGE_luci-app-qbittorrent=m
CONFIG_PACKAGE_luci-app-qos=y
CONFIG_PACKAGE_luci-app-serverchan=m
CONFIG_PACKAGE_luci-app-sqm=y
CONFIG_PACKAGE_luci-app-ssr-plus=m
CONFIG_PACKAGE_luci-app-ssr-plus_INCLUDE_IPT2Socks=y
CONFIG_PACKAGE_luci-app-ssr-plus_INCLUDE_Kcptun=y
CONFIG_PACKAGE_luci-app-ssr-plus_INCLUDE_NaiveProxy=y
CONFIG_PACKAGE_luci-app-ssr-plus_INCLUDE_Redsocks2=y
CONFIG_PACKAGE_luci-app-ssr-plus_INCLUDE_Shadowsocks_Rust_Client=y
CONFIG_PACKAGE_luci-app-ssr-plus_INCLUDE_Shadowsocks_Rust_Server=y
CONFIG_PACKAGE_luci-app-ssr-plus_INCLUDE_Trojan=y
CONFIG_PACKAGE_luci-app-ssr-plus_INCLUDE_V2ray_Plugin=y
CONFIG_PACKAGE_luci-app-timecontrol=y
CONFIG_PACKAGE_luci-app-udpxy=m
CONFIG_PACKAGE_luci-app-unblockmusic=m
CONFIG_PACKAGE_luci-app-usb-printer=m
CONFIG_PACKAGE_luci-app-uugamebooster=m
CONFIG_PACKAGE_luci-app-vpnbypass=m
CONFIG_PACKAGE_luci-app-xlnetacc=m
CONFIG_PACKAGE_luci-app-zerotier=m
CONFIG_PACKAGE_luci-i18n-airplay2-zh-cn=m
CONFIG_PACKAGE_luci-i18n-aliyundrive-webdav-zh-cn=m
CONFIG_PACKAGE_luci-i18n-base-en=y
CONFIG_PACKAGE_luci-i18n-bonding-en=y
CONFIG_PACKAGE_luci-i18n-ddns-en=y
CONFIG_PACKAGE_luci-i18n-diskman-zh-cn=m
CONFIG_PACKAGE_luci-i18n-firewall-en=y
CONFIG_PACKAGE_luci-i18n-frpc-zh-cn=m
CONFIG_PACKAGE_luci-i18n-frps-zh-cn=m
CONFIG_PACKAGE_luci-i18n-hd-idle-en=y
CONFIG_PACKAGE_luci-i18n-ipsec-vpnserver-manyusers-zh-cn=m
CONFIG_PACKAGE_luci-i18n-kodexplorer-zh-cn=m
CONFIG_PACKAGE_luci-i18n-minidlna-en=m
CONFIG_PACKAGE_luci-i18n-minidlna-zh-cn=m
CONFIG_PACKAGE_luci-i18n-netdata-zh-cn=y
CONFIG_PACKAGE_luci-i18n-nft-qos-zh-cn=y
CONFIG_PACKAGE_luci-i18n-openvpn-en=m
CONFIG_PACKAGE_luci-i18n-openvpn-server-zh-cn=m
CONFIG_PACKAGE_luci-i18n-openvpn-zh-cn=m
CONFIG_PACKAGE_luci-i18n-passwall-zh-cn=y
CONFIG_PACKAGE_luci-i18n-passwall2-zh-cn=m
CONFIG_PACKAGE_luci-i18n-pptp-server-zh-cn=m
CONFIG_PACKAGE_luci-i18n-qbittorrent-zh-cn=m
CONFIG_PACKAGE_luci-i18n-qos-en=y
CONFIG_PACKAGE_luci-i18n-qos-zh-cn=y
CONFIG_PACKAGE_luci-i18n-samba-en=y
CONFIG_PACKAGE_luci-i18n-sqm-en=y
CONFIG_PACKAGE_luci-i18n-sqm-zh-cn=y
CONFIG_PACKAGE_luci-i18n-ssr-plus-zh-cn=m
CONFIG_PACKAGE_luci-i18n-timecontrol-zh-cn=y
CONFIG_PACKAGE_luci-i18n-unblockmusic-zh-cn=m
CONFIG_PACKAGE_luci-i18n-upnp-en=y
CONFIG_PACKAGE_luci-i18n-usb-printer-zh-cn=m
CONFIG_PACKAGE_luci-i18n-uugamebooster-zh-cn=m
CONFIG_PACKAGE_luci-i18n-vpnbypass-zh-cn=m
CONFIG_PACKAGE_luci-i18n-watchcat-en=y
CONFIG_PACKAGE_luci-i18n-wol-en=y
CONFIG_PACKAGE_luci-i18n-xlnetacc-zh-cn=m
CONFIG_PACKAGE_luci-i18n-zerotier-zh-cn=m
CONFIG_PACKAGE_luci-proto-ipip=y
CONFIG_PACKAGE_luci-proto-openconnect=y
CONFIG_PACKAGE_luci-proto-relay=y
CONFIG_PACKAGE_luci-proto-vpnc=y
CONFIG_PACKAGE_luci-theme-argon-18.06=y
CONFIG_PACKAGE_luci-theme-edge=y
CONFIG_PACKAGE_luci-theme-material=y
CONFIG_PACKAGE_mdadm=m
CONFIG_PACKAGE_microsocks=y
CONFIG_PACKAGE_minidlna=m
CONFIG_PACKAGE_miniupnpc=y
CONFIG_PACKAGE_miniupnpd-iptables=y
# CONFIG_PACKAGE_miniupnpd-nftables is not set
CONFIG_PACKAGE_mount-utils=y
CONFIG_PACKAGE_naiveproxy=y
CONFIG_PACKAGE_nano-full=y
CONFIG_PACKAGE_natpmpc=y
CONFIG_PACKAGE_netdata=y
CONFIG_PACKAGE_nft-qos=y
CONFIG_PACKAGE_nftables-nojson=y
CONFIG_PACKAGE_nginx-ssl=m
CONFIG_PACKAGE_nginx-ssl-util=m
CONFIG_PACKAGE_nginx-util=m
CONFIG_PACKAGE_oniguruma=m
CONFIG_PACKAGE_open-vm-tools-fuse=y
CONFIG_PACKAGE_openconnect=y
CONFIG_PACKAGE_openssh-sftp-server=y
CONFIG_PACKAGE_openvpn-easy-rsa=m
CONFIG_PACKAGE_openvpn-openssl=m
CONFIG_PACKAGE_p11-kit=y
CONFIG_PACKAGE_p910nd=m
CONFIG_PACKAGE_parted=m
CONFIG_PACKAGE_php8=m
CONFIG_PACKAGE_php8-cgi=m
CONFIG_PACKAGE_php8-fastcgi=m
CONFIG_PACKAGE_php8-fpm=m
CONFIG_PACKAGE_php8-mod-curl=m
CONFIG_PACKAGE_php8-mod-dom=m
CONFIG_PACKAGE_php8-mod-gd=m
CONFIG_PACKAGE_php8-mod-iconv=m
CONFIG_PACKAGE_php8-mod-mbstring=m
CONFIG_PACKAGE_php8-mod-mysqlnd=m
CONFIG_PACKAGE_php8-mod-opcache=m
CONFIG_PACKAGE_php8-mod-pdo=m
CONFIG_PACKAGE_php8-mod-pdo-mysql=m
CONFIG_PACKAGE_php8-mod-pdo-sqlite=m
CONFIG_PACKAGE_php8-mod-session=m
CONFIG_PACKAGE_php8-mod-sqlite3=m
CONFIG_PACKAGE_php8-mod-xml=m
CONFIG_PACKAGE_php8-mod-xmlreader=m
CONFIG_PACKAGE_php8-mod-xmlwriter=m
CONFIG_PACKAGE_php8-mod-zip=m
CONFIG_PACKAGE_pptpd=m
CONFIG_PACKAGE_ps3netsrv=m
# CONFIG_PACKAGE_python3 is not set
# CONFIG_PACKAGE_python3-asyncio is not set
# CONFIG_PACKAGE_python3-base is not set
# CONFIG_PACKAGE_python3-certifi is not set
# CONFIG_PACKAGE_python3-cgi is not set
# CONFIG_PACKAGE_python3-cgitb is not set
# CONFIG_PACKAGE_python3-chardet is not set
# CONFIG_PACKAGE_python3-click is not set
# CONFIG_PACKAGE_python3-codecs is not set
# CONFIG_PACKAGE_python3-ctypes is not set
# CONFIG_PACKAGE_python3-dbm is not set
# CONFIG_PACKAGE_python3-decimal is not set
# CONFIG_PACKAGE_python3-distutils is not set
# CONFIG_PACKAGE_python3-email is not set
# CONFIG_PACKAGE_python3-flask is not set
# CONFIG_PACKAGE_python3-flask-restful is not set
# CONFIG_PACKAGE_python3-gdbm is not set
# CONFIG_PACKAGE_python3-idna is not set
# CONFIG_PACKAGE_python3-itsdangerous is not set
# CONFIG_PACKAGE_python3-jinja2 is not set
# CONFIG_PACKAGE_python3-light is not set
# CONFIG_PACKAGE_python3-logging is not set
# CONFIG_PACKAGE_python3-lzma is not set
# CONFIG_PACKAGE_python3-markupsafe is not set
# CONFIG_PACKAGE_python3-multiprocessing is not set
# CONFIG_PACKAGE_python3-ncurses is not set
# CONFIG_PACKAGE_python3-openssl is not set
# CONFIG_PACKAGE_python3-pkg-resources is not set
# CONFIG_PACKAGE_python3-pydoc is not set
# CONFIG_PACKAGE_python3-readline is not set
# CONFIG_PACKAGE_python3-requests is not set
# CONFIG_PACKAGE_python3-setuptools is not set
# CONFIG_PACKAGE_python3-sqlite3 is not set
# CONFIG_PACKAGE_python3-unittest is not set
# CONFIG_PACKAGE_python3-urllib is not set
# CONFIG_PACKAGE_python3-urllib3 is not set
# CONFIG_PACKAGE_python3-werkzeug is not set
# CONFIG_PACKAGE_python3-xml is not set
CONFIG_PACKAGE_qBittorrent-static=m
CONFIG_PACKAGE_qos-scripts=y
CONFIG_PACKAGE_r8152-firmware=y
CONFIG_PACKAGE_redsocks2=m
CONFIG_PACKAGE_relayd=y
CONFIG_PACKAGE_rtl8192ce-firmware=y
CONFIG_PACKAGE_rtl8192cu-firmware=y
CONFIG_PACKAGE_rtl8192de-firmware=y
CONFIG_PACKAGE_rtl8192se-firmware=y
CONFIG_PACKAGE_rtl8192su-firmware=y
CONFIG_PACKAGE_rtl8821ae-firmware=y
CONFIG_PACKAGE_shadowsocks-libev-ss-local=y
CONFIG_PACKAGE_shadowsocks-libev-ss-redir=y
CONFIG_PACKAGE_shadowsocks-libev-ss-server=y
CONFIG_PACKAGE_shadowsocks-rust-sslocal=y
CONFIG_PACKAGE_shadowsocks-rust-ssserver=m
CONFIG_PACKAGE_shadowsocksr-libev-ssr-check=m
CONFIG_PACKAGE_shadowsocksr-libev-ssr-local=y
CONFIG_PACKAGE_shadowsocksr-libev-ssr-redir=y
CONFIG_PACKAGE_shadowsocksr-libev-ssr-server=y
CONFIG_PACKAGE_shairport-sync-openssl=m
CONFIG_PACKAGE_simple-obfs=y
CONFIG_PACKAGE_smartmontools=m
CONFIG_PACKAGE_snmp-utils=y
CONFIG_PACKAGE_snmpd=y
CONFIG_PACKAGE_snmptrapd=y
CONFIG_PACKAGE_sqm-scripts=y
CONFIG_PACKAGE_strongswan=m
CONFIG_PACKAGE_strongswan-charon=m
CONFIG_PACKAGE_strongswan-default=m
CONFIG_PACKAGE_strongswan-mod-aes=m
CONFIG_PACKAGE_strongswan-mod-attr=m
CONFIG_PACKAGE_strongswan-mod-connmark=m
CONFIG_PACKAGE_strongswan-mod-constraints=m
CONFIG_PACKAGE_strongswan-mod-des=m
CONFIG_PACKAGE_strongswan-mod-dhcp=m
CONFIG_PACKAGE_strongswan-mod-dnskey=m
CONFIG_PACKAGE_strongswan-mod-eap-mschapv2=m
CONFIG_PACKAGE_strongswan-mod-farp=m
CONFIG_PACKAGE_strongswan-mod-fips-prf=m
CONFIG_PACKAGE_strongswan-mod-gmp=m
CONFIG_PACKAGE_strongswan-mod-hmac=m
CONFIG_PACKAGE_strongswan-mod-kernel-netlink=m
CONFIG_PACKAGE_strongswan-mod-md4=m
CONFIG_PACKAGE_strongswan-mod-md5=m
CONFIG_PACKAGE_strongswan-mod-nonce=m
CONFIG_PACKAGE_strongswan-mod-pem=m
CONFIG_PACKAGE_strongswan-mod-pgp=m
CONFIG_PACKAGE_strongswan-mod-pkcs1=m
CONFIG_PACKAGE_strongswan-mod-pubkey=m
CONFIG_PACKAGE_strongswan-mod-random=m
CONFIG_PACKAGE_strongswan-mod-rc2=m
CONFIG_PACKAGE_strongswan-mod-resolve=m
CONFIG_PACKAGE_strongswan-mod-revocation=m
CONFIG_PACKAGE_strongswan-mod-sha1=m
CONFIG_PACKAGE_strongswan-mod-sha2=m
CONFIG_PACKAGE_strongswan-mod-socket-default=m
CONFIG_PACKAGE_strongswan-mod-sshkey=m
CONFIG_PACKAGE_strongswan-mod-updown=m
CONFIG_PACKAGE_strongswan-mod-vici=m
CONFIG_PACKAGE_strongswan-mod-x509=m
CONFIG_PACKAGE_strongswan-mod-xauth-generic=m
CONFIG_PACKAGE_strongswan-mod-xcbc=m
CONFIG_PACKAGE_strongswan-swanctl=m
# CONFIG_PACKAGE_subconverter is not set
# CONFIG_PACKAGE_subweb is not set
CONFIG_PACKAGE_tc-full=y
CONFIG_PACKAGE_tc-mod-iptables=y
CONFIG_PACKAGE_tcping=y
CONFIG_PACKAGE_trojan=m
CONFIG_PACKAGE_trojan-go=y
CONFIG_PACKAGE_trojan-plus=y
CONFIG_PACKAGE_uclibcxx=y
CONFIG_PACKAGE_udpxy=m
CONFIG_PACKAGE_urngd=y
CONFIG_PACKAGE_uugamebooster=m
CONFIG_PACKAGE_v2ray-geoip=y
CONFIG_PACKAGE_v2ray-geosite=y
CONFIG_PACKAGE_v2ray-plugin=y
CONFIG_PACKAGE_vpnbypass=m
CONFIG_PACKAGE_vpnc=y
CONFIG_PACKAGE_vpnc-scripts=y
CONFIG_PACKAGE_xray-core=y
CONFIG_PACKAGE_zerotier=m
CONFIG_PACKAGE_zoneinfo-asia=m
CONFIG_PACKAGE_zoneinfo-core=m
CONFIG_PHP8_LIBXML=y
CONFIG_PHP8_SYSTEMTZDATA=y
CONFIG_SOCAT_SSL=y
CONFIG_STRONGSWAN_ROUTING_TABLE="220"
CONFIG_STRONGSWAN_ROUTING_TABLE_PRIO="220"
CONFIG_TARGET_EXT4_BLOCKSIZE=4096
CONFIG_TARGET_EXT4_BLOCKSIZE_4K=y
CONFIG_TARGET_EXT4_RESERVED_PCT=0
CONFIG_TARGET_IMAGES_GZIP=y
CONFIG_TARGET_ROOTFS_EXT4FS=y
CONFIG_TARGET_ROOTFS_PARTSIZE=2031
CONFIG_VPNC_OPENSSL=y
# CONFIG_ZLIB_OPTIMIZE_SPEED is not set
CONFIG_boost-compile-visibility-hidden=y
CONFIG_boost-runtime-shared=y
CONFIG_boost-static-and-shared-libs=y
CONFIG_boost-variant-release=y
CONFIG_PACKAGE_libbz2=y
CONFIG_PACKAGE_libdb47=y
CONFIG_PACKAGE_libevent2=y
```
